## Documentation/devicetree/bindings/media/allwinner,sun60i-a733-isp.yaml
```yaml
# SPDX-License-Identifier: (GPL-2.0 OR BSD-2-Clause)
%YAML 1.2
---
$id: http://devicetree.org/schemas/media/allwinner,sun60i-a733-isp.yaml#
$schema: http://devicetree.org/meta-schemas/core.yaml#

title: Allwinner A733 Image Signal Processor (ISP 602)

maintainers:
  - Tim Michals <tcmichals@gmail.com>

description:
  The Allwinner A733 SoC features a hardware Image Signal Processor (ISP 602)
  connected to the camera pipeline (CSI_TOP). Unlike earlier generations (e.g. V3s),
  the ISP has no private output DMA engine; processed pixel streams route directly
  through VIPP into the CSI DMA capture channel.

properties:
  compatible:
    enum:
      - allwinner,sun60i-a733-isp
      - allwinner,sun55i-a523-isp

  reg:
    maxItems: 1

  interrupts:
    maxItems: 1

  clocks:
    minItems: 2
    items:
      - description: Module Clock (ISP core clock)
      - description: DRAM / MBUS Clock (Memory bus clock)
      - description: AHB Bus Clock (Video-In / CSI bus clock)

  clock-names:
    minItems: 2
    items:
      - const: mod
      - const: ram
      - const: bus

  resets:
    maxItems: 1

  power-domains:
    maxItems: 1

  ports:
    $ref: /schemas/graph.yaml#/properties/ports

    properties:
      port@0:
        $ref: /schemas/graph.yaml#/properties/port
        description: Input port from CSI bridge

      port@1:
        $ref: /schemas/graph.yaml#/properties/port
        description: Output port to CSI capture

    required:
      - port@0

required:
  - compatible
  - reg
  - interrupts
  - clocks
  - clock-names
  - power-domains
  - ports

additionalProperties: false

examples:
  - |
    #include <dt-bindings/interrupt-controller/arm-gic.h>
    #include <dt-bindings/clock/sun55i-a523-ccu.h>
    #include <dt-bindings/power/allwinner,sun60i-a733-pck600.h>

    isp: isp@5900000 {
        compatible = "allwinner,sun60i-a733-isp";
        reg = <0x05900000 0x1300>;
        interrupts = <GIC_SPI 129 IRQ_TYPE_LEVEL_HIGH>;
        clocks = <&ccu CLK_ISP>,
                 <&ccu CLK_MBUS_ISP>;
        clock-names = "mod", "ram";
        power-domains = <&pck600 PD_VI>;

        ports {
            #address-cells = <1>;
            #size-cells = <0>;

            port@0 {
                reg = <0>;

                isp_in_csi: endpoint {
                    remote-endpoint = <&csi_out_isp>;
                };
            };

            port@1 {
                reg = <1>;

                isp_out_csi: endpoint {
                    remote-endpoint = <&csi_in_isp>;
                };
            };
        };
    };
```

## drivers/media/platform/sunxi/sun60i-isp/Kconfig
```kconfig
# SPDX-License-Identifier: GPL-2.0-only
config VIDEO_SUN60I_ISP
	tristate "Allwinner A733 / T527 Hardware ISP (ISP 602) support"
	depends on V4L_PLATFORM_DRIVERS
	depends on VIDEO_DEV && HAS_DMA
	select MEDIA_CONTROLLER
	select VIDEO_V4L2_SUBDEV_API
	select V4L2_FWNODE
	help
	  This is a driver for the Allwinner A733 / T527 Hardware Image
	  Signal Processor (ISP 602).

	  To compile this driver as a module, choose M here: the module
	  will be called sun60i-isp.
```
