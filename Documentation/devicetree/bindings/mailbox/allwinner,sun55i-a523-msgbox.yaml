## Documentation/devicetree/bindings/mailbox/allwinner,sun55i-a523-msgbox.yaml
```yaml
# SPDX-License-Identifier: (GPL-2.0-only OR BSD-2-Clause)
%YAML 1.2
---
$id: http://devicetree.org/schemas/mailbox/allwinner,sun55i-a523-msgbox.yaml#
$schema: http://devicetree.org/meta-schemas/core.yaml#

title: Allwinner A523 Message Box

maintainers:
  - Tim Michals <tcmichals@gmail.com>

description:
  The message box on the Allwinner A523, A527 and T527 (sun55i) SoCs links
  four processors - the Cortex-A55 cluster, the HiFi4 DSP, the CPUS power
  management core and the XuanTie E906 RISC-V core. Each processor has its
  own register bank holding 8-entry receive FIFOs for messages from the
  other three, and a sender writes into the receiver's bank. The host side
  therefore uses all four banks and exposes 12 channels, 4 per remote
  processor. Each bank has its own bus clock and reset, and an unclocked
  bank drops writes, so the host needs all four. A bank's read interrupt
  goes to the processor that owns it; its write interrupt, raised while the
  FIFO has room, goes to the sender on a separate line.

properties:
  compatible:
    const: allwinner,sun55i-a523-msgbox

  reg:
    items:
      - description: Cortex-A55 host bank
      - description: HiFi4 DSP bank
      - description: CPUS bank
      - description: XuanTie RISC-V bank

  reg-names:
    items:
      - const: arm
      - const: dsp
      - const: cpus
      - const: rv

  clocks:
    items:
      - description: Cortex-A55 host bank bus clock
      - description: HiFi4 DSP bank bus clock
      - description: CPUS bank bus clock
      - description: XuanTie RISC-V bank bus clock

  clock-names:
    items:
      - const: arm
      - const: dsp
      - const: cpus
      - const: rv

  resets:
    items:
      - description: Cortex-A55 host bank reset
      - description: HiFi4 DSP bank reset
      - description: CPUS bank reset
      - description: XuanTie RISC-V bank reset

  reset-names:
    items:
      - const: arm
      - const: dsp
      - const: cpus
      - const: rv

  interrupts:
    items:
      - description: Cortex-A55 bank read interrupt, messages for the host
      - description: HiFi4 DSP bank write interrupt for the host
      - description: CPUS bank write interrupt for the host
      - description: XuanTie RISC-V bank write interrupt for the host

  interrupt-names:
    items:
      - const: arm
      - const: dsp
      - const: cpus
      - const: rv

  allwinner,tx-done-irq:
    type: boolean
    description:
      Signal TX done with the write interrupt of the receiver's bank instead
      of polling. A message is done once the receiver's FIFO has room for the
      next one either way; the write interrupt is raised while the FIFO has
      room. Without this property a full FIFO is polled. Received messages
      use the host bank read interrupt either way.

  '#mbox-cells':
    const: 1
    description:
      Host channel number. Channels 0-3 reach the CPUS, 4-7 the DSP and
      8-11 the RISC-V core.

required:
  - compatible
  - reg
  - reg-names
  - clocks
  - clock-names
  - resets
  - reset-names
  - interrupts
  - interrupt-names
  - '#mbox-cells'

additionalProperties: false

examples:
  - |
    #include <dt-bindings/clock/sun55i-a523-ccu.h>
    #include <dt-bindings/clock/sun55i-a523-mcu-ccu.h>
    #include <dt-bindings/clock/sun55i-a523-r-ccu.h>
    #include <dt-bindings/interrupt-controller/arm-gic.h>
    #include <dt-bindings/reset/sun55i-a523-ccu.h>
    #include <dt-bindings/reset/sun55i-a523-mcu-ccu.h>
    #include <dt-bindings/reset/sun55i-a523-r-ccu.h>

    mailbox@3003000 {
        compatible = "allwinner,sun55i-a523-msgbox";
        reg = <0x03003000 0x1000>,
              <0x07120000 0x1000>,
              <0x07094000 0x1000>,
              <0x07136000 0x1000>;
        reg-names = "arm", "dsp", "cpus", "rv";
        clocks = <&ccu CLK_BUS_MSGBOX>,
                 <&mcu_ccu CLK_BUS_MCU_DSP_MSGBOX>,
                 <&r_ccu CLK_BUS_R_MSGBOX>,
                 <&mcu_ccu CLK_BUS_MCU_RISCV_MSGBOX>;
        clock-names = "arm", "dsp", "cpus", "rv";
        resets = <&ccu RST_BUS_MSGBOX>,
                 <&mcu_ccu RST_BUS_MCU_DSP_MSGBOX>,
                 <&r_ccu RST_BUS_R_MSGBOX>,
                 <&mcu_ccu RST_BUS_MCU_RISCV_MSGBOX>;
        reset-names = "arm", "dsp", "cpus", "rv";
        interrupts = <GIC_SPI 0 IRQ_TYPE_LEVEL_HIGH>,
                     <GIC_SPI 181 IRQ_TYPE_LEVEL_HIGH>,
                     <GIC_SPI 174 IRQ_TYPE_LEVEL_HIGH>,
                     <GIC_SPI 205 IRQ_TYPE_LEVEL_HIGH>;
        interrupt-names = "arm", "dsp", "cpus", "rv";
        #mbox-cells = <1>;
    };
```

## Documentation/devicetree/bindings/mailbox/allwinner,sun60i-a733-msgbox.yaml
```yaml
# SPDX-License-Identifier: (GPL-2.0-only OR BSD-2-Clause)
%YAML 1.2
---
$id: http://devicetree.org/schemas/mailbox/allwinner,sun60i-a733-msgbox.yaml#
$schema: http://devicetree.org/meta-schemas/core.yaml#

title: Allwinner A733 Message Box

maintainers:
  - Tim Michals <tcmichals@gmail.com>

description:
  The message box on the Allwinner A733 (sun60i) links two processors - the
  Cortex-A76/A55 host (CPUX_MSGBOX bank) and the CPUS core, a XuanTie E902
  RISC-V core (S_MBOX bank). It works like the A523 message box with two
  banks instead of four, each with 8-entry receive FIFOs, and each side
  reaches the other on its port 0. The host exposes 4 channels, all to the
  E902. Each bank has its own bus clock and reset, and the host needs both.

properties:
  compatible:
    const: allwinner,sun60i-a733-msgbox

  reg:
    items:
      - description: Host bank (CPUX_MSGBOX)
      - description: CPUS (E902) bank (S_MBOX)

  reg-names:
    items:
      - const: arm
      - const: cpus

  clocks:
    items:
      - description: Host bank bus clock
      - description: CPUS bank bus clock

  clock-names:
    items:
      - const: arm
      - const: cpus

  resets:
    items:
      - description: Host bank reset
      - description: CPUS bank reset

  reset-names:
    items:
      - const: arm
      - const: cpus

  interrupts:
    minItems: 1
    items:
      - description: Host bank read interrupt, messages for the host
      - description: CPUS bank write interrupt for the host

  interrupt-names:
    minItems: 1
    items:
      - const: arm
      - const: cpus

  allwinner,tx-done-irq:
    type: boolean
    description:
      Signal TX done with the write interrupt of the CPUS bank instead of
      polling. Needs both interrupts.

  '#mbox-cells':
    const: 1
    description:
      Host channel number. Channels 0-3 reach the CPUS (E902) core.

required:
  - compatible
  - reg
  - reg-names
  - clocks
  - clock-names
  - resets
  - reset-names
  - interrupts
  - '#mbox-cells'

if:
  required:
    - allwinner,tx-done-irq
then:
  properties:
    interrupts:
      minItems: 2
    interrupt-names:
      minItems: 2

additionalProperties: false

examples:
  - |
    #include <dt-bindings/clock/allwinner,sun60i-a733-ccu.h>
    #include <dt-bindings/clock/allwinner,sun60i-a733-r-ccu.h>
    #include <dt-bindings/interrupt-controller/arm-gic.h>
    #include <dt-bindings/reset/allwinner,sun60i-a733-ccu.h>
    #include <dt-bindings/reset/allwinner,sun60i-a733-r-ccu.h>

    mailbox@3004000 {
        compatible = "allwinner,sun60i-a733-msgbox";
        reg = <0x03004000 0x1000>,
              <0x07094000 0x1000>;
        reg-names = "arm", "cpus";
        clocks = <&ccu CLK_BUS_MSGBOX0>, <&r_ccu CLK_BUS_R_MSGBOX>;
        clock-names = "arm", "cpus";
        resets = <&ccu RST_BUS_MSGBOX>, <&r_ccu RST_BUS_R_MSGBOX>;
        reset-names = "arm", "cpus";
        interrupts = <GIC_SPI 0 IRQ_TYPE_LEVEL_HIGH>,
                     <GIC_SPI 211 IRQ_TYPE_LEVEL_HIGH>;
        interrupt-names = "arm", "cpus";
        #mbox-cells = <1>;
    };
```

## Documentation/devicetree/bindings/phy/allwinner,sun60i-a733-usb2-phy.yaml
```yaml
# SPDX-License-Identifier: (GPL-2.0 OR BSD-2-Clause)
%YAML 1.2
---
$id: http://devicetree.org/schemas/phy/allwinner,sun60i-a733-usb2-phy.yaml#
$schema: http://devicetree.org/meta-schemas/core.yaml#

title: Allwinner A733 USB 2.0 PHY

maintainers:
  - Tim Michals <tcmichals@gmail.com>

properties:
  compatible:
    enum:
      - allwinner,sun60i-a733-usb2-phy
      - allwinner,sunxi-plat-phy

  reg:
    maxItems: 1

  power-domains:
    maxItems: 1

  vbus-supply:
    description: Regulator controlling VBUS power to the downstream port

  allwinner,phy-tune-param:
    $ref: /schemas/types.yaml#/definitions/uint32
    description: Analog tuning parameters for squelch, pre-emphasis, and DCAP

  aw,phy_tune_param:
    $ref: /schemas/types.yaml#/definitions/uint32
    description: Legacy analog tuning parameter property

  "#phy-cells":
    const: 0

required:
  - compatible
  - reg
  - "#phy-cells"

additionalProperties: false

examples:
  - |
    #include <dt-bindings/power/allwinner,sun60i-a733-pck-600.h>

    phy@6b00000 {
        compatible = "allwinner,sun60i-a733-usb2-phy";
        reg = <0x06b00000 0x800>;
        power-domains = <&pck600 PD_USB2>;
        allwinner,phy-tune-param = <0x143338d6>;
        #phy-cells = <0>;
    };
```

## Documentation/devicetree/bindings/remoteproc/allwinner,sun55i-a523-rproc.yaml
```yaml
# SPDX-License-Identifier: (GPL-2.0-only OR BSD-2-Clause)
%YAML 1.2
---
$id: http://devicetree.org/schemas/remoteproc/allwinner,sun55i-a523-rproc.yaml#
$schema: http://devicetree.org/meta-schemas/core.yaml#

title: Allwinner A523 XuanTie E906 RISC-V Remote Processor

maintainers:
  - Tim Michals <tcmichals@gmail.com>

description:
  The Allwinner A523, A527 and T527 (sun55i) SoCs contain a T-Head XuanTie
  E906 RISC-V core next to the Cortex-A55 cluster. The core runs from a
  dedicated 256 KiB SRAM, can also use a second 256 KiB SRAM and DRAM,
  and a remap register shared with the HiFi4 DSP shares a further 512 KiB
  SRAM (SRAM A3_2) with the core's subsystem. Its reset vector is set in a
  register of its configuration block, and it exchanges notifications with
  the Cortex-A55 host through the message box.

properties:
  compatible:
    const: allwinner,sun55i-a523-rproc

  reg:
    items:
      - description: Configuration block, including the boot address register
      - description: SRAM A3_0, the core's dedicated SRAM space 0
      - description: SRAM A3_1, the core's SRAM space 1
      - description: SRAM remap control register

  reg-names:
    items:
      - const: cfg
      - const: sram-a3-0
      - const: sram-a3-1
      - const: remap

  clocks:
    items:
      - description: Configuration block bus clock
      - description: RISC-V core clock
      - description: MCU public SRAM bus clock

  clock-names:
    items:
      - const: bus
      - const: core
      - const: sram

  resets:
    items:
      - description: Configuration block reset
      - description: RISC-V core reset
      - description: MCU public SRAM reset
      - description: RISC-V debug module reset

  reset-names:
    items:
      - const: cfg
      - const: core
      - const: sram
      - const: debug

  mboxes:
    description:
      Message box channel to the RISC-V core. Each channel has a FIFO in
      each direction, so it carries notifications both ways.
    maxItems: 1

  firmware-name:
    maxItems: 1

  memory-region:
    minItems: 1
    items:
      - description: Virtio vring and buffer pool, a shared-dma-pool
      - description: Firmware code and data in DRAM
      - description: Trace buffer

  memory-region-names:
    minItems: 1
    items:
      - const: vram
      - const: dram
      - const: trace

  interrupts:
    maxItems: 1
    description:
      Interrupt the RISC-V core raises on a fatal error. The A523 has no
      dedicated line for this, so it is present only where the system
      integration provides one.

  power-domains:
    items:
      - description: RISC-V core power domain
      - description: SRAM power domain

  power-domain-names:
    items:
      - const: riscv
      - const: sram

required:
  - compatible
  - reg
  - reg-names
  - clocks
  - clock-names
  - resets
  - reset-names
  - power-domains
  - power-domain-names

additionalProperties: false

examples:
  - |
    #include <dt-bindings/clock/sun55i-a523-mcu-ccu.h>
    #include <dt-bindings/power/allwinner,sun55i-a523-ppu.h>
    #include <dt-bindings/reset/sun55i-a523-mcu-ccu.h>

    remoteproc@7130000 {
        compatible = "allwinner,sun55i-a523-rproc";
        reg = <0x07130000 0x1000>,
              <0x07280000 0x40000>,
              <0x072c0000 0x40000>,
              <0x07010364 0x4>;
        reg-names = "cfg", "sram-a3-0", "sram-a3-1", "remap";
        clocks = <&mcu_ccu CLK_BUS_MCU_RISCV_CFG>,
                 <&mcu_ccu CLK_MCU_RISCV>,
                 <&mcu_ccu CLK_BUS_MCU_PUBSRAM>;
        clock-names = "bus", "core", "sram";
        resets = <&mcu_ccu RST_BUS_MCU_RISCV_CFG>,
                 <&mcu_ccu RST_BUS_MCU_RISCV_CORE>,
                 <&mcu_ccu RST_BUS_MCU_PUBSRAM>,
                 <&mcu_ccu RST_BUS_MCU_RISCV_DEBUG>;
        reset-names = "cfg", "core", "sram", "debug";
        power-domains = <&ppu PD_RISCV>, <&ppu PD_SRAM>;
        power-domain-names = "riscv", "sram";
        mboxes = <&msgbox 9>;
        memory-region = <&riscv_vram>, <&riscv_dram>;
        memory-region-names = "vram", "dram";
        firmware-name = "riscv-firmware.elf";
    };
```

## drivers/phy/allwinner/Kconfig
```kconfig
# SPDX-License-Identifier: GPL-2.0-only
#
# Phy drivers for Allwinner platforms
#
config PHY_SUN4I_USB
	tristate "Allwinner sunxi SoC USB PHY driver"
	depends on ARCH_SUNXI || COMPILE_TEST
	depends on HAS_IOMEM
	depends on RESET_CONTROLLER
	depends on EXTCON
	depends on POWER_SUPPLY
	depends on USB_SUPPORT
	select GENERIC_PHY
	select USB_COMMON
	help
	  Enable this to support the transceiver that is part of Allwinner
	  sunxi SoCs.

	  This driver controls the entire USB PHY block, both the USB OTG
	  parts, as well as the 2 regular USB 2 host PHYs.

config PHY_SUN60I_USB2
	tristate "Allwinner sun60i A733 USB 2.0 PHY driver"
	depends on ARCH_SUNXI || COMPILE_TEST
	depends on HAS_IOMEM
	select GENERIC_PHY
	default y if ARCH_SUNXI
	help
	  Enable this to support the USB 2.0 PHY transceiver dedicated to the
	  DWC3 controller on Allwinner A733 (sun60iw2) SoCs.

config PHY_SUN6I_MIPI_DPHY
	tristate "Allwinner A31 MIPI D-PHY Support"
	depends on ARCH_SUNXI || COMPILE_TEST
	depends on HAS_IOMEM && COMMON_CLK
	depends on RESET_CONTROLLER
	select GENERIC_PHY
	select GENERIC_PHY_MIPI_DPHY
	select REGMAP_MMIO
	help
	  Choose this option if you have an Allwinner SoC with
	  MIPI-DSI support. If M is selected, the module will be
	  called sun6i_mipi_dphy.

config PHY_SUN9I_USB
	tristate "Allwinner sun9i SoC USB PHY driver"
	depends on ARCH_SUNXI || COMPILE_TEST
	depends on HAS_IOMEM
	depends on RESET_CONTROLLER
	depends on USB_SUPPORT
	select USB_COMMON
	select GENERIC_PHY
	help
	  Enable this to support the transceiver that is part of Allwinner
	  sun9i SoCs.

	  This driver controls each individual USB 2 host PHY.

config PHY_SUN50I_USB3
	tristate "Allwinner H6 SoC USB3 PHY driver"
	depends on ARCH_SUNXI || COMPILE_TEST
	depends on HAS_IOMEM && OF
	depends on RESET_CONTROLLER
	select GENERIC_PHY
	help
	  Enable this to support the USB3.0-capable transceiver that is
	  part of Allwinner H6 SoC.

	  This driver controls each individual USB 2+3 host PHY combo.
```
